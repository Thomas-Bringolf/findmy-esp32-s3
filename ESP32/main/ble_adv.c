#include <string.h>
#include <stdio.h>

#include "esp_log.h"
#include "esp_timer.h"
#include "esp_bt.h"
#include "freertos/FreeRTOS.h"
#include "freertos/task.h"
#include "freertos/timers.h"

#include "nimble/nimble_port.h"
#include "host/ble_hs.h"
#include "host/ble_uuid.h"
#include "services/gap/ble_svc_gap.h"

#include "findmy_keys.h"
#include "config.h"
#include "beacon.h"

static const char *LOG_TAG = "open_haystack";

/* Controller status "command disallowed" (ble_hs_hci.c keeps this private) */
#define HCI_ERR_CMD_DISALLOWED 0x0c

/* extern in beacon.h: main.c owns the status byte (adv_data[6]) and copies
 * the whole frame into RTC memory before deep sleep. */
uint8_t adv_data[ADV_DATA_LEN] = {
    0x1e, 0xff, 0x4c, 0x00, 0x12, 0x19, 0x00,
    0x00, 0x00, 0x00, 0x00, 0x00, 0x00, 0x00, 0x00,
    0x00, 0x00, 0x00, 0x00, 0x00, 0x00, 0x00, 0x00,
    0x00, 0x00, 0x00, 0x00, 0x00, 0x00,
};

static struct ble_gap_adv_params ble_adv_params = {
    .conn_mode       = BLE_GAP_CONN_MODE_NON,
    .disc_mode       = BLE_GAP_DISC_MODE_NON,
    .itvl_min        = 0x0C80,
    .itvl_max        = 0x0C80,
    .channel_map     = 0x07,
    .filter_policy   = BLE_HCI_ADV_FILT_NONE,
    .high_duty_cycle = 0,
};

/* True between a successful ble_gap_adv_start() and the next stop. */
static bool advertising = false;

/* publish_once()/shutdown() mode: one short burst per call, so ADV_COMPLETE
 * (which only the controller can raise) is never a rotation hook. */
static bool manual_adv = false;
static esp_timer_handle_t rotation_timer = NULL;
static TimerHandle_t adv_log_timer = NULL;

/* BLE random-static identity address (from key[0..5]). This is advertised
 * via the controller, separate from the manufacturer-data payload.
 * Byte 5's top bits are forced to 11 so NimBLE accepts it as a valid
 * random static address (it validates addr[5] & 0xc0 must be 0x00 or 0xc0). */
static uint8_t beacon_addr[6] = { 0, 0, 0, 0, 0, 0 };

#define LOGV(format, ...) \
    do { if (fm_debug_enabled()) ESP_LOGI(LOG_TAG, format, ##__VA_ARGS__); } while (0)

static void log_adv_payload(const char *prefix, const uint8_t *data, size_t len)
{
    char line[128];
    size_t pos = 0;
    pos += snprintf(line + pos, sizeof(line) - pos, "%s (len=%zu): ", prefix, len);
    for (size_t i = 0; i < len && pos < sizeof(line) - 4; i++) {
        pos += snprintf(line + pos, sizeof(line) - pos, "%02x ", data[i]);
    }
    ESP_LOGI(LOG_TAG, "%s", line);
}

static void adv_log_timer_cb(TimerHandle_t xTimer)
{
    log_adv_payload("BLE ADV", adv_data, sizeof(adv_data));
}

/* Tracks the `advertising` flag: true exactly while the controller holds a
 * non-connectable instance started by start_adv(). Asking the controller to
 * disable an instance that is not running answers "command disallowed",
 * which would only produce log noise, so the flag is checked first. */
static int stop_adv(void)
{
    int rc;

    if (!advertising) {
        return BLE_HS_EALREADY;
    }
    rc = ble_gap_adv_stop();
    if (rc == 0 || rc == BLE_HS_EALREADY ||
        rc == BLE_HS_HCI_ERR(HCI_ERR_CMD_DISALLOWED)) {
        advertising = false;
        rc = (rc == 0) ? 0 : BLE_HS_EALREADY;
    }
    return rc;
}

/* NimBLE never reports BLE_GAP_EVENT_ADV_COMPLETE for a stop that the host
 * itself requested (legacy advertising: ble_gap_adv_stop() only sends
 * LE_SET_ADV_ENABLE=0). Every "stop, then wait for the callback" pattern
 * would therefore block until its timeout, so stopping is treated as
 * synchronous - ble_gap_adv_stop() completes the HCI command before it
 * returns. */
static int gap_event_cb(struct ble_gap_event *event, void *arg);

static void apply_adv_interval(void)
{
    /* adv_ms -> BLE units (0.625 ms). Controller allows 0x20..0x4000. */
    uint32_t ms = fm_get_adv_ms();
    uint32_t units = (ms * 8u) / 5u;
    if (units < 0x20) units = 0x20;
    if (units > 0x4000) units = 0x4000;
    ble_adv_params.itvl_min = units;
    ble_adv_params.itvl_max = units;
}

static int start_adv(void)
{
    apply_adv_interval();
    int rc = ble_gap_adv_start(BLE_OWN_ADDR_RANDOM, NULL, BLE_HS_FOREVER,
                               &ble_adv_params, gap_event_cb, NULL);
    if (rc == 0) {
        advertising = true;
    }
    return rc;
}

static int set_adv_data(void)
{
    struct ble_hs_adv_fields fields = {0};

    /* adv_data[0..1] = len/type header (generated by NimBLE), adv_data[2..30]
     * is the full manufacturer-specific value = Apple company ID (0x4c 00)
     * followed by the offline-finding frame. ble_hs_adv_fields has no separate
     * company-id member, so the company ID must be part of mfg_data. Passing
     * the header bytes here too would exceed the 31-byte legacy budget. */
    fields.mfg_data = adv_data + 2;
    fields.mfg_data_len = sizeof(adv_data) - 2;
    return ble_gap_adv_set_fields(&fields);
}

static void set_addr_from_key(uint8_t *addr, uint8_t *public_key)
{
    addr[0] = public_key[0] | 0b11000000;
    addr[1] = public_key[1];
    addr[2] = public_key[2];
    addr[3] = public_key[3];
    addr[4] = public_key[4];
    addr[5] = (public_key[5] & 0x3f) | 0xC0;   /* valid random static for NimBLE */
}

static void set_payload_from_key(uint8_t *payload, uint8_t *public_key)
{
    memcpy(&payload[7], &public_key[6], 22);
    payload[29] = public_key[0] >> 6;
}

void ble_adv_publish_frame(void)
{
    memcpy(rtc_state.adv, adv_data, sizeof(adv_data));
    memcpy(rtc_state.addr, beacon_addr, 6);
    rtc_state.paired = 1;
    rtc_state.magic = FM_RTC_MAGIC;
    rtc_state.sleep_bit = 0;
}

void ble_adv_restore_frame(void)
{
    memcpy(adv_data, rtc_state.adv, sizeof(adv_data));
    memcpy(beacon_addr, rtc_state.addr, 6);
}

void ble_adv_apply_current_key(void)
{
    static uint8_t public_key[28];

    if (fm_current_pubkey(public_key) != 0) {
        ESP_LOGE(LOG_TAG, "key derivation failed");
        return;
    }
    set_addr_from_key(beacon_addr, public_key);
    set_payload_from_key(adv_data, public_key);

    ESP_LOGI(LOG_TAG, "slot=%u public key X: %02x%02x%02x%02x%02x%02x%02x%02x"
                      "%02x%02x%02x%02x%02x%02x%02x%02x%02x%02x%02x%02x"
                      "%02x%02x%02x%02x%02x%02x%02x%02x",
                      fm_current_slot(),
                      public_key[0],  public_key[1],  public_key[2],  public_key[3],
                      public_key[4],  public_key[5],  public_key[6],  public_key[7],
                      public_key[8],  public_key[9],  public_key[10], public_key[11],
                      public_key[12], public_key[13], public_key[14], public_key[15],
                      public_key[16], public_key[17], public_key[18], public_key[19],
                      public_key[20], public_key[21], public_key[22], public_key[23],
                      public_key[24], public_key[25], public_key[26], public_key[27]);
    LOGV("device address: %02x %02x %02x %02x %02x %02x",
         beacon_addr[0], beacon_addr[1], beacon_addr[2],
         beacon_addr[3], beacon_addr[4], beacon_addr[5]);
    ble_adv_publish_frame();
}

static void rotation_timer_cb(void *arg)
{
    if (!fm_is_paired() || !advertising || manual_adv) {
        return;
    }
    LOGV("slot boundary, rotating key...");
    if (stop_adv() != 0) {
        ESP_LOGE(LOG_TAG, "rotation: could not stop advertising");
        return;
    }
    if (fm_key_init() == 0 && fm_advance_slot() == 0) {
        ble_adv_apply_current_key();
    } else {
        ESP_LOGE(LOG_TAG, "key rotation failed");
    }
    ble_adv_start_chain();
}

static void start_rotation_timer(void)
{
    const uint64_t period_us = (uint64_t)fm_get_rot_sec() * 1000000ULL;

    if (rotation_timer == NULL) {
        const esp_timer_create_args_t targs = {
            .callback = rotation_timer_cb,
            .name = "fm_rotate",
        };
        if (esp_timer_create(&targs, &rotation_timer) != ESP_OK) {
            ESP_LOGE(LOG_TAG, "couldn't create rotation timer");
            return;
        }
    }
    /* Re-arm on every call so a CONFIG rot_sec change takes effect right
     * away instead of at the next boot. Stopping a timer that is not
     * running returns ESP_ERR_INVALID_STATE - harmless here. */
    (void)esp_timer_stop(rotation_timer);
    if (esp_timer_start_periodic(rotation_timer, period_us) != ESP_OK) {
        ESP_LOGE(LOG_TAG, "couldn't start rotation timer");
        return;
    }
    LOGV("key rotation every %u s", (unsigned)fm_get_rot_sec());
}

/* One-shot payload dump at start; while debug is enabled a repeating timer
 * keeps dumping it every 2 s (created once, never per event). */
static void start_adv_log_timer(void)
{
    if (!fm_debug_enabled()) {
        return;
    }
    if (adv_log_timer == NULL) {
        adv_log_timer = xTimerCreate("adv_log", pdMS_TO_TICKS(2000),
                                     pdTRUE, NULL, adv_log_timer_cb);
        if (adv_log_timer == NULL) {
            return;
        }
    }
    if (!xTimerIsTimerActive(adv_log_timer)) {
        xTimerStart(adv_log_timer, 0);
    }
}

/* Bookkeeping for every successful continuous-mode start (debug session,
 * rotation, re-key). The short publish_once() bursts deliberately skip it. */
static void on_adv_started(void)
{
    LOGV("advertising started");
    log_adv_payload("BLE ADV", adv_data, sizeof(adv_data));
    start_adv_log_timer();
    start_rotation_timer();
}

void app_on_keys_changed(void)
{
    ble_adv_apply_current_key();
    start_rotation_timer();

    /* start_chain() stops any running instance first, so a single call is
     * enough; there is no callback to wait for (see the note above
     * gap_event_cb). */
    ble_adv_start_chain();
}

/* Only the status byte (adv_data[6]) changed: refresh the frame on air.
 * Keys, device address, interval and rotation are untouched, so there is
 * no reason to run the whole re-key path - and none to log the MAC again.
 * The stop is synchronous and a stop we ask for never raises ADV_COMPLETE
 * (see the note above gap_event_cb), so no restart race. */
void ble_adv_set_status(void)
{
    int rc;

    if (!advertising) {
        return;   /* not advertising yet: start_chain() sends the byte */
    }
    if (stop_adv() != 0) {
        ESP_LOGE(LOG_TAG, "status update: could not stop advertising");
        return;
    }
    rc = set_adv_data();
    if (rc == 0) {
        rc = start_adv();
    }
    if (rc != 0) {
        ESP_LOGE(LOG_TAG, "status update: couldn't restart advertising: %d", rc);
    }
}

static int gap_event_cb(struct ble_gap_event *event, void *arg)
{
    switch (event->type) {
    case BLE_GAP_EVENT_ADV_COMPLETE:
        /* A stop we asked for never produces this event, so reaching it
         * means the controller dropped the instance on its own. Restart,
         * otherwise the beacon would stay silent until the next reset. */
        if (manual_adv) {
            break;
        }
        ESP_LOGW(LOG_TAG, "advertising ended unexpectedly, restarting");
        ble_adv_start_chain();
        break;

    default:
        break;
    }
    return 0;
}

static bool wait_synced(uint32_t timeout_ms)
{
    const TickType_t deadline = xTaskGetTickCount() + pdMS_TO_TICKS(timeout_ms);

    while (!ble_hs_synced()) {
        if ((int32_t)(xTaskGetTickCount() - deadline) >= 0) {
            return false;
        }
        vTaskDelay(pdMS_TO_TICKS(10));
    }
    return true;
}

static void on_sync(void)
{
    ESP_LOGI(LOG_TAG, "NimBLE host synced");

    /* Host is up: safe to call host APIs. Set the random static identity
     * address first, then start advertising via the single idempotent
     * entry point. */
    int rc = ble_hs_id_set_rnd(beacon_addr);
    if (rc != 0) {
        ESP_LOGE(LOG_TAG, "set rnd addr failed: %d", rc);
    }
    ble_adv_start_chain();
}

static void on_reset(int reason)
{
    ESP_LOGE(LOG_TAG, "NimBLE reset: %d", reason);
}

/* nimble_port_init() initializes AND enables the BT controller itself, so
 * there is no separate controller setup step here. */

/* Set once the NimBLE host exists. ble_hs_synced() itself dereferences the
 * host state, so calling it before nimble_port_init() panics - guard every
 * start path with this instead of trusting the call order. */
static bool host_ready = false;

static void nimble_host_task(void *param)
{
    nimble_port_run();
    vTaskDelete(NULL);
}

void ble_adv_host_init(void)
{
    nimble_port_init();
    ble_hs_cfg.sync_cb = on_sync;
    ble_hs_cfg.reset_cb = on_reset;
    ble_hs_cfg.gatts_register_cb = NULL;
    ble_hs_cfg.store_status_cb = NULL;

    /* Find My is a non-connectable broadcaster: no GAP/GATT services are
     * registered. Host APIs (ble_hs_id_set_rnd, ble_gap_adv_*) are only
     * called from on_sync() once the NimBLE host is up. */

    esp_ble_tx_power_set(ESP_BLE_PWR_TYPE_ADV, ESP_PWR_LVL_P9);

    host_ready = true;

    /* Start the NimBLE host event loop. This is what drives the host and
     * causes on_sync() to fire once the controller syncs. Without it the
     * host stays "disabled" (BLE_HS_EDISABLED) and nothing advertises. */
    xTaskCreate(nimble_host_task, "fm_nimble_host", 4096, NULL, 5, NULL);
}

void ble_adv_shutdown(void)
{
    manual_adv = true;
    host_ready = false;
    stop_adv();
    vTaskDelay(pdMS_TO_TICKS(10));   /* let the controller process the stop */
    nimble_port_stop();
    esp_bt_controller_disable();
}

/* BlueZ/bleak print BLE addresses with the bytes reversed relative to how
 * the firmware stores them (b0..b5 -> b5..b0), so print both orders. */
static void log_beacon_mac(void)
{
    static uint8_t last[6] = {0};
    static bool logged = false;

    if (logged && memcmp(last, beacon_addr, 6) == 0) {
        return;   /* same address as the previous broadcast */
    }
    memcpy(last, beacon_addr, 6);
    logged = true;

    ESP_LOGI(LOG_TAG,
             "adv mac addr: %02x:%02x:%02x:%02x:%02x:%02x (bluez: "
             "%02x:%02x:%02x:%02x:%02x:%02x)",
             beacon_addr[0], beacon_addr[1], beacon_addr[2],
             beacon_addr[3], beacon_addr[4], beacon_addr[5],
             beacon_addr[5], beacon_addr[4], beacon_addr[3],
             beacon_addr[2], beacon_addr[1], beacon_addr[0]);
}

void ble_adv_start_chain(void)
{
    if (!fm_is_paired()) {
        return;
    }
    /* Continuous mode: ADV_COMPLETE events must never be swallowed as
     * publish_once() noise. */
    manual_adv = false;
    /* Host APIs fail with BLE_HS_ENOTSYNCED until the NimBLE host syncs
     * with the controller. on_sync() re-invokes us once synced. Before
     * ble_adv_host_init() they do not fail - they fault - hence host_ready. */
    if (!host_ready || !ble_hs_synced()) {
        return;
    }
    /* Stop first: makes repeated calls (boot on_sync + debug session +
     * pairing re-key) idempotent and avoids BLE_HS_EBUSY on re-entry. */
    stop_adv();
    int rc = ble_hs_id_set_rnd(beacon_addr);
    if (rc != 0) {
        ESP_LOGE(LOG_TAG, "set rnd addr failed: %d", rc);
    }
    rc = set_adv_data();
    if (rc == 0) {
        rc = start_adv();
    }
    if (rc != 0) {
        ESP_LOGE(LOG_TAG, "couldn't start advertising: %d", rc);
        return;
    }
    log_beacon_mac();
    on_adv_started();
}

bool ble_adv_publish_once(void)
{
    manual_adv = true;

    if (!wait_synced(2000)) {
        return false;
    }

    stop_adv();
    int rc = ble_hs_id_set_rnd(beacon_addr);
    if (rc != 0) {
        ESP_LOGE(LOG_TAG, "set rnd addr failed: %d", rc);
    }
    rc = set_adv_data();
    if (rc != 0) return false;
    rc = start_adv();
    if (rc != 0) return false;
    log_beacon_mac();

    /* Keep the instance alive long enough for one on-air event. The guard
     * must be at least one tick: at 100 Hz pdMS_TO_TICKS(5) is 0, and a
     * zero delay would busy-spin instead of yielding to the idle task. */
    TickType_t guard = pdMS_TO_TICKS(FM_ADV_GUARD_MS);
    vTaskDelay(guard ? guard : 1);

    return stop_adv() == 0;
}

#pragma GCC diagnostic pop
